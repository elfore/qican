## YY1/cpScript/INF_downsample_4M/sample.yaml
```yaml
outpath: /mnt/gpfs/Dataset/04.project/Bioinfo/99.Sequencer_assessment/01.BK/02.Analysis/04.new_qican/S100/SE75/SKII15404/INF_downsample_4M

sample:
  - sampleid: CN002477-S03-R01-L26-P04_IB
    fqpath: /mnt/me4_nfs/02.analysis/260702171042_B170_SKII15404-R2JC-ZY-YY-260702171043/Primary/FASTQ/L000//CN002477-S03-R01-L26-P04_L000_R1.fq.gz
    runid: SKII15404
    NA_type: "NA"
    seq_type: "SEQ"
    control_type: "sample"
  - sampleid: LC003694-S02-D01-L37-P08_IB
    fqpath: /mnt/me4_nfs/02.analysis/260702171042_B170_SKII15404-R2JC-ZY-YY-260702171043/Primary/FASTQ/L000//LC003694-S02-D01-L37-P08_L000_R1.fq.gz
    runid: SKII15404
    NA_type: "NA"
    seq_type: "SEQ"
    control_type: "sample"
  - sampleid: LC003571-S03-D01-L19-P09_IB
    fqpath: /mnt/me4_nfs/02.analysis/260702171042_B170_SKII15404-R2JC-ZY-YY-260702171043/Primary/FASTQ/L000//LC003571-S03-D01-L19-P09_L000_R1.fq.gz
    runid: SKII15404
    NA_type: "NA"
    seq_type: "SEQ"
    control_type: "sample"
  - sampleid: CN002477-S09-R01-L01-P06_IB
    fqpath: /mnt/me4_nfs/02.analysis/260702171042_B170_SKII15404-R2JC-ZY-YY-260702171043/Primary/FASTQ/L000//CN002477-S09-R01-L01-P06_L000_R1.fq.gz
    runid: SKII15404
    NA_type: "NA"
    seq_type: "SEQ"
    control_type: "sample"
  - sampleid: 12_flu-L02-P65_IA
    fqpath: /mnt/me4_nfs/02.analysis/260702171042_B170_SKII15404-R2JC-ZY-YY-260702171043/Primary/FASTQ/L000//12_flu-L02-P65_L000_R1.fq.gz
    runid: SKII15404
    NA_type: "NA"
    seq_type: "SEQ"
    control_type: "sample"
  - sampleid: 17_flu-L02-P66_IA
    fqpath: /mnt/me4_nfs/02.analysis/260702171042_B170_SKII15404-R2JC-ZY-YY-260702171043/Primary/FASTQ/L000//17_flu-L02-P66_L000_R1.fq.gz
    runid: SKII15404
    NA_type: "NA"
    seq_type: "SEQ"
    control_type: "sample"
  - sampleid: 21_flu-L01-P68_IA
    fqpath: /mnt/me4_nfs/02.analysis/260702171042_B170_SKII15404-R2JC-ZY-YY-260702171043/Primary/FASTQ/L000//21_flu-L01-P68_L000_R1.fq.gz
    runid: SKII15404
    NA_type: "NA"
    seq_type: "SEQ"
    control_type: "sample"
```

## YY2/cpScript/newNational/sample.yaml
```yaml
workdir: /mnt/gpfs1/Dataset/04.project/Bioinfo/99.Sequencer_assessment/01.BK/02.Analysis/04.new_qican/S100/PE150/skID/newNational/ 
seqmode: PE
fastp_par: " "
sample:
  BRCA_CN002712-S01-D02-L01-CUDI23: /mnt/me4_nfs/02.analysis/batchID/Primary/FASTQ/L000/CN002712-S01-D02-L01-CUDI23_L000_R1.fq.gz;/mnt/me4_nfs/02.analysis/batchID/Primary/FASTQ/L000/CN002712-S01-D02-L01-CUDI23_L000_R2.fq.gz
  Ecoli_CN002707-S01-D01-L01-CUDI39: /mnt/me4_nfs/02.analysis/batchID/Primary/FASTQ/L000/CN002707-S01-D01-L01-CUDI39_L000_R1.fq.gz;/mnt/me4_nfs/02.analysis/batchID/Primary/FASTQ/L000/CN002707-S01-D01-L01-CUDI39_L000_R2.fq.gz
  HighGC_CN002708-S01-D01-L01-CUDI40: /mnt/me4_nfs/02.analysis/batchID/Primary/FASTQ/L000/CN002708-S01-D01-L01-CUDI40_L000_R1.fq.gz;/mnt/me4_nfs/02.analysis/batchID/Primary/FASTQ/L000/CN002708-S01-D01-L01-CUDI40_L000_R2.fq.gz
  LowGC_CN002709-S01-D01-L01-CUDI41: /mnt/me4_nfs/02.analysis/batchID/Primary/FASTQ/L000/CN002709-S01-D01-L01-CUDI41_L000_R1.fq.gz;/mnt/me4_nfs/02.analysis/batchID/Primary/FASTQ/L000/CN002709-S01-D01-L01-CUDI41_L000_R2.fq.gz
  SE31_CN002710-S01-D01-L01-CUDI42: /mnt/me4_nfs/02.analysis/batchID/Primary/FASTQ/L000/CN002710-S01-D01-L01-CUDI42_L000_R1.fq.gz;/mnt/me4_nfs/02.analysis/batchID/Primary/FASTQ/L000/CN002710-S01-D01-L01-CUDI42_L000_R2.fq.gz
  SynII_CN002711-S01-D01-L01-CUDI43: /mnt/me4_nfs/02.analysis/batchID/Primary/FASTQ/L000/CN002711-S01-D01-L01-CUDI43_L000_R1.fq.gz;/mnt/me4_nfs/02.analysis/batchID/Primary/FASTQ/L000/CN002711-S01-D01-L01-CUDI43_L000_R2.fq.gz
```

## YY2/cpScriptSE/SE_1/newNational/sample.yaml
```yaml
workdir: /mnt/gpfs1/Dataset/04.project/Bioinfo/99.Sequencer_assessment/01.BK/02.Analysis/04.new_qican/S100/PE150/SKII15275_SE_1/newNational/
seqmode: SE
fastp_par: " "
sample:
  BRCA_CN002712-S01-D02-L01-CUDI23: /mnt/me4_nfs/02.analysis/260508150833_B162_SKII15275-YY2BRS2hot-260508150833/Primary/FASTQ_Read1/L000/CN002712-S01-D02-L01-CUDI23_L000_R1.fq.gz
  Ecoli_CN002707-S01-D01-L01-CUDI39: /mnt/me4_nfs/02.analysis/260508150833_B162_SKII15275-YY2BRS2hot-260508150833/Primary/FASTQ_Read1/L000/CN002707-S01-D01-L01-CUDI39_L000_R1.fq.gz
  HighGC_CN002708-S01-D01-L01-CUDI40: /mnt/me4_nfs/02.analysis/260508150833_B162_SKII15275-YY2BRS2hot-260508150833/Primary/FASTQ_Read1/L000/CN002708-S01-D01-L01-CUDI40_L000_R1.fq.gz
  LowGC_CN002709-S01-D01-L01-CUDI41: /mnt/me4_nfs/02.analysis/260508150833_B162_SKII15275-YY2BRS2hot-260508150833/Primary/FASTQ_Read1/L000/CN002709-S01-D01-L01-CUDI41_L000_R1.fq.gz
  SE31_CN002710-S01-D01-L01-CUDI42: /mnt/me4_nfs/02.analysis/260508150833_B162_SKII15275-YY2BRS2hot-260508150833/Primary/FASTQ_Read1/L000/CN002710-S01-D01-L01-CUDI42_L000_R1.fq.gz
  SynII_CN002711-S01-D01-L01-CUDI43: /mnt/me4_nfs/02.analysis/260508150833_B162_SKII15275-YY2BRS2hot-260508150833/Primary/FASTQ_Read1/L000/CN002711-S01-D01-L01-CUDI43_L000_R1.fq.gz
```

## YY2/cpScriptSE/SE_2/tumor_panel/sample.yaml
```yaml
workdir: /mnt/gpfs/Dataset/04.project/Bioinfo/99.Sequencer_assessment/01.BK/02.Analysis/04.new_qican/S100/PE150/skID_SE_2/tumor_panel/result
mode: SE
genome_version: hg19_decoy
bed: /mnt/gpfs/Dataset/04.project/Bioinfo/99.Sequencer_assessment/01.BK/02.Analysis/06.FGRT/tumor_panel/bed/TargetSeq_V2-T893V1_hg19.bed
sample:
  skID_3-CN001872-S02-D01-L02-UDI70: /mnt/me4_nfs/02.analysis/batchID/Primary/FASTQ_Read1/L000/CN001872-S02-D01-L02-UDI70_L000_R1.fq.gz
```
